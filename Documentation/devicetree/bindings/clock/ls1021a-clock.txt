## drivers/soc/fsl/Kconfig
```kconfig
if ARM
source "drivers/soc/fsl/Kconfig.arm"
endif

config FSL_QIXIS
	tristate "QIXIS system controller driver"
	depends on FSL_SOC_DRIVERS
	select REGMAP_I2C
	select REGMAP_MMIO
	default n
	help
	  Say y here to enable QIXIS system controller api.  The qixis driver
	  provides FPGA functions to control system.
```

## drivers/soc/qe/Kconfig
```kconfig
#
# QE Communication options
#

config QUICC_ENGINE
	bool "Freescale QUICC Engine (QE) Support"
	select LIB_RHEAP
	select CRC32
	---help---
	  The QUICC Engine (QE) is a new generation of communications
	  coprocessors on Freescale embedded CPUs (akin to CPM in older chips).
	  Selecting this option means that you wish to build a kernel
	  for a machine with a QE coprocessor.

config QE_GPIO
	bool "QE GPIO support"
	depends on QUICC_ENGINE
	select ARCH_REQUIRE_GPIOLIB
	---help---
	  Say Y here if you're going to use hardware that connects to the
	  QE GPIOs.


config UCC_SLOW
	bool
	default y if SERIAL_QE
	help
	  This option provides qe_lib support to UCC slow
	  protocols: UART, BISYNC, QMC

config UCC_FAST
	bool
	default y if UCC_GETH || FSL_UCC_TDM || FSL_UCC_HDLC
	help
	  This option provides qe_lib support to UCC fast
	  protocols: HDLC, Ethernet, ATM, transparent

config UCC
	bool
	default y if UCC_FAST || UCC_SLOW

config QE_USB
	bool
	default y if USB_FSL_QE
	help
	  QE USB Controller support
```

## drivers/tdm/device/Kconfig
```kconfig
#
# TDM device configuration
#

menu "TDM Device support"

config TDM_FSL
        tristate "Driver for Freescale TDM controller"
        depends on FSL_SOC
        ---help---
          This is a driver for Freescale TDM controller. The controller
          is found in various Freescale SOCs viz MPC8315, P1020. The TDM driver
          basically multiplexes and demultiplexes data from different channels.
          The TDM can interface SLIC kind of devices.
endmenu
```

## drivers/tdm/line_ctrl/Kconfig
```kconfig
#
# TDM line control driver config file
#

menu "Line Control Devices"

config SLIC_ZARLINK
	tristate "Zarlink Slic intialization Module"
		default n
		---help---
		  This module initialize and configure the zarlink slic
endmenu
```

## drivers/tdm/test/Kconfig
```kconfig
#
# TDM TEST MODULE
#

menu "TDM test"

config TDM_TEST
        tristate "TDM test Module"
	depends on FSL_SOC
	---help---
	  This TDM test module is a small test module which
	  registers with the TDM core(framework) and sets up
	  a TDM Voice path between diff channels of a slic.

config UCC_TDM_TEST
	tristate "UCC TDM test Module"
	depends on FSL_SOC || QUICC_ENGINE
	---help---
	  This UCC TDM test module is a small test module to test
	  ucc tdm transfer and receive data via ucc1.

config TDM_LOOPBACK_TEST
        tristate "TDM Loopback test Module"
	depends on FSL_SOC
	---help---
	  This TDM Loopback test module is a small test module which
	  performs a simple internal loopback testing.

endmenu
```
