## arch/powerpc/configs/85xx/p1023rds_chk_defconfig
```kconfig
CONFIG_PPC_85xx=y
CONFIG_PHYS_64BIT=y
CONFIG_SMP=y
CONFIG_NR_CPUS=2
CONFIG_EXPERIMENTAL=y
CONFIG_SYSVIPC=y
CONFIG_POSIX_MQUEUE=y
CONFIG_BSD_PROCESS_ACCT=y
CONFIG_AUDIT=y
CONFIG_SPARSE_IRQ=y
CONFIG_IKCONFIG=y
CONFIG_IKCONFIG_PROC=y
CONFIG_LOG_BUF_SHIFT=14
CONFIG_BLK_DEV_INITRD=y
CONFIG_EMBEDDED=y
CONFIG_PERF_EVENTS=y
CONFIG_MODULES=y
CONFIG_MODULE_UNLOAD=y
CONFIG_MODULE_FORCE_UNLOAD=y
CONFIG_MODVERSIONS=y
# CONFIG_BLK_DEV_BSG is not set
CONFIG_MPC8540_ADS=y
CONFIG_MPC8560_ADS=y
CONFIG_MPC85xx_CDS=y
CONFIG_MPC85xx_MDS=y
CONFIG_MPC8536_DS=y
CONFIG_MPC85xx_DS=y
CONFIG_MPC85xx_RDB=y
CONFIG_P1023_RDS=y
CONFIG_SOCRATES=y
CONFIG_KSI8560=y
CONFIG_XES_MPC85xx=y
CONFIG_STX_GP3=y
CONFIG_TQM8540=y
CONFIG_TQM8541=y
CONFIG_TQM8548=y
CONFIG_TQM8555=y
CONFIG_TQM8560=y
CONFIG_SBC8548=y
CONFIG_QUICC_ENGINE=y
CONFIG_QE_GPIO=y
CONFIG_MPC8xxx_GPIO=y
CONFIG_HIGHMEM=y
CONFIG_NO_HZ=y
CONFIG_HIGH_RES_TIMERS=y
CONFIG_PREEMPT_LL=y
# CONFIG_CORE_DUMP_DEFAULT_ELF_HEADERS is not set
CONFIG_BINFMT_MISC=m
CONFIG_MATH_EMULATION=y
CONFIG_HAS_FSL_QBMAN=y
CONFIG_PCI=y
CONFIG_PCIEPORTBUS=y
# CONFIG_PCIEAER is not set
# CONFIG_PCIEASPM is not set
CONFIG_PCI_MSI=y
CONFIG_NET=y
CONFIG_PACKET=y
CONFIG_UNIX=y
CONFIG_XFRM_USER=y
CONFIG_NET_KEY=y
CONFIG_INET=y
CONFIG_IP_MULTICAST=y
CONFIG_IP_ADVANCED_ROUTER=y
CONFIG_IP_MULTIPLE_TABLES=y
CONFIG_IP_ROUTE_MULTIPATH=y
CONFIG_IP_ROUTE_VERBOSE=y
CONFIG_IP_PNP=y
CONFIG_IP_PNP_DHCP=y
CONFIG_IP_PNP_BOOTP=y
CONFIG_IP_PNP_RARP=y
CONFIG_NET_IPIP=y
CONFIG_IP_MROUTE=y
CONFIG_IP_PIMSM_V1=y
CONFIG_IP_PIMSM_V2=y
CONFIG_ARPD=y
CONFIG_INET_ESP=y
# CONFIG_INET_XFRM_MODE_BEET is not set
# CONFIG_INET_LRO is not set
CONFIG_IPV6=y
CONFIG_IP_SCTP=m
CONFIG_UEVENT_HELPER_PATH="/sbin/hotplug"
CONFIG_PROC_DEVICETREE=y
CONFIG_BLK_DEV_LOOP=y
CONFIG_BLK_DEV_RAM=y
CONFIG_BLK_DEV_RAM_SIZE=131072
CONFIG_MISC_DEVICES=y
CONFIG_EEPROM_LEGACY=y
CONFIG_BLK_DEV_SD=y
CONFIG_CHR_DEV_ST=y
CONFIG_BLK_DEV_SR=y
CONFIG_CHR_DEV_SG=y
CONFIG_SCSI_MULTI_LUN=y
CONFIG_SCSI_LOGGING=y
CONFIG_ATA=y
CONFIG_SATA_FSL=y
CONFIG_SATA_SIL24=y
CONFIG_NETDEVICES=y
CONFIG_DUMMY=y
CONFIG_MARVELL_PHY=y
CONFIG_DAVICOM_PHY=y
CONFIG_CICADA_PHY=y
CONFIG_VITESSE_PHY=y
CONFIG_FIXED_PHY=y
CONFIG_NET_ETHERNET=y
CONFIG_FS_ENET=y
CONFIG_E1000E=y
CONFIG_FSL_PQ_MDIO=y
CONFIG_DPA=y
CONFIG_INPUT_FF_MEMLESS=m
# CONFIG_INPUT_MOUSEDEV is not set
# CONFIG_INPUT_KEYBOARD is not set
# CONFIG_INPUT_MOUSE is not set
CONFIG_SERIO_LIBPS2=y
CONFIG_SERIAL_8250=y
CONFIG_SERIAL_8250_CONSOLE=y
CONFIG_SERIAL_8250_NR_UARTS=2
CONFIG_SERIAL_8250_RUNTIME_UARTS=2
CONFIG_SERIAL_8250_EXTENDED=y
CONFIG_SERIAL_8250_MANY_PORTS=y
CONFIG_SERIAL_8250_DETECT_IRQ=y
CONFIG_SERIAL_8250_RSA=y
CONFIG_SERIAL_QE=m
CONFIG_NVRAM=y
CONFIG_I2C=y
CONFIG_I2C_CPM=m
CONFIG_I2C_MPC=y
# CONFIG_HWMON is not set
CONFIG_VIDEO_OUTPUT_CONTROL=y
CONFIG_SOUND=y
CONFIG_SND=y
CONFIG_SND_MIXER_OSS=y
CONFIG_SND_PCM_OSS=y
# CONFIG_SND_SUPPORT_OLD_API is not set
CONFIG_EDAC=y
CONFIG_EDAC_MM_EDAC=y
CONFIG_RTC_CLASS=y
CONFIG_RTC_DRV_CMOS=y
CONFIG_DMADEVICES=y
CONFIG_FSL_DMA=y
# CONFIG_NET_DMA is not set
CONFIG_STAGING=y
CONFIG_FMAN_P1023=y
CONFIG_EXT2_FS=y
CONFIG_EXT3_FS=y
# CONFIG_EXT3_DEFAULTS_TO_ORDERED is not set
CONFIG_ISO9660_FS=m
CONFIG_JOLIET=y
CONFIG_ZISOFS=y
CONFIG_UDF_FS=m
CONFIG_MSDOS_FS=m
CONFIG_VFAT_FS=y
CONFIG_NTFS_FS=y
CONFIG_PROC_KCORE=y
CONFIG_TMPFS=y
CONFIG_HUGETLBFS=y
CONFIG_ADFS_FS=m
CONFIG_AFFS_FS=m
CONFIG_HFS_FS=m
CONFIG_HFSPLUS_FS=m
CONFIG_BEFS_FS=m
CONFIG_BFS_FS=m
CONFIG_EFS_FS=m
CONFIG_CRAMFS=y
CONFIG_VXFS_FS=m
CONFIG_HPFS_FS=m
CONFIG_QNX4FS_FS=m
CONFIG_SYSV_FS=m
CONFIG_UFS_FS=m
CONFIG_NFS_FS=y
CONFIG_NFS_V3=y
CONFIG_NFS_V4=y
CONFIG_ROOT_NFS=y
CONFIG_NFSD=y
CONFIG_PARTITION_ADVANCED=y
CONFIG_MAC_PARTITION=y
CONFIG_CRC_T10DIF=y
CONFIG_PRINTK_TIME=y
CONFIG_FRAME_WARN=8092
CONFIG_MAGIC_SYSRQ=y
CONFIG_DEBUG_KERNEL=y
CONFIG_DEBUG_SHIRQ=y
CONFIG_LOCKUP_DETECTOR=y
CONFIG_DETECT_HUNG_TASK=y
CONFIG_DEBUG_KMEMLEAK=y
CONFIG_DEBUG_RT_MUTEXES=y
CONFIG_PROVE_LOCKING=y
CONFIG_PROVE_RCU=y
CONFIG_SPARSE_RCU_POINTER=y
CONFIG_DEBUG_LOCKDEP=y
CONFIG_DEBUG_SPINLOCK_SLEEP=y
# CONFIG_DEBUG_BUGVERBOSE is not set
CONFIG_DEBUG_INFO=y
CONFIG_DEBUG_MEMORY_INIT=y
CONFIG_DEBUG_LIST=y
CONFIG_DEBUG_SG=y
CONFIG_DEBUG_NOTIFIERS=y
CONFIG_DEBUG_CREDENTIALS=y
CONFIG_DEBUG_FORCE_WEAK_PER_CPU=y
CONFIG_DEBUG_PER_CPU_MAPS=y
CONFIG_SYSCTL_SYSCALL_CHECK=y
CONFIG_DEBUG_PAGEALLOC=y
CONFIG_FUNCTION_TRACER=y
CONFIG_DMA_API_DEBUG=y
CONFIG_DEBUG_STACKOVERFLOW=y
CONFIG_VIRQ_DEBUG=y
CONFIG_CRYPTO_PCBC=m
CONFIG_CRYPTO_SHA256=y
CONFIG_CRYPTO_SHA512=y
CONFIG_CRYPTO_AES=y
# CONFIG_CRYPTO_ANSI_CPRNG is not set
CONFIG_CRYPTO_DEV_FSL_CAAM=y
```

## drivers/cpufreq/Kconfig.powerpc
```kconfig
config CPU_FREQ_CBE
	tristate "CBE frequency scaling"
	depends on CBE_RAS && PPC_CELL
	select CPU_FREQ_TABLE
	default m
	help
	  This adds the cpufreq driver for Cell BE processors.
	  For details, take a look at <file:Documentation/cpu-freq/>.
	  If you don't have such processor, say N

config CPU_FREQ_CBE_PMI
	bool "CBE frequency scaling using PMI interface"
	depends on CPU_FREQ_CBE
	default n
	help
	  Select this, if you want to use the PMI interface to switch
	  frequencies. Using PMI, the processor will not only be able to run at
	  lower speed, but also at lower core voltage.

config CPU_FREQ_MAPLE
	bool "Support for Maple 970FX Evaluation Board"
	depends on PPC_MAPLE
	select CPU_FREQ_TABLE
	help
	  This adds support for frequency switching on Maple 970FX
	  Evaluation Board and compatible boards (IBM JS2x blades).

config MPC85xx_CPUFREQ
	bool "Support for Freescale MPC85xx CPU freq"
	depends on PPC_85xx && PPC32 && !PPC_E500MC
	default n
	help
	  This adds support for dynamic frequency switching on
	  Freescale MPC85xx by cpufreq interface. MPC8536 and P1022
	  have a JOG feature, which provides a dynamic mechanism
	  to lower or raise the CPU core clock at runtime.

config QORIQ_CPUFREQ
	tristate "CPU frequency scaling driver for Freescale QorIQ SoCs"
	depends on OF && COMMON_CLK
	select CLK_QORIQ
	help
	  This adds the CPUFreq driver support for Freescale QorIQ SoCs
	  which are capable of changing the CPU's frequency dynamically.

config CPU_FREQ_PMAC
	bool "Support for Apple PowerBooks"
	depends on ADB_PMU && PPC32
	select CPU_FREQ_TABLE
	help
	  This adds support for frequency switching on Apple PowerBooks,
	  this currently includes some models of iBook & Titanium
	  PowerBook.

config CPU_FREQ_PMAC64
	bool "Support for some Apple G5s"
	depends on PPC_PMAC && PPC64
	select CPU_FREQ_TABLE
	help
	  This adds support for frequency switching on Apple iMac G5,
	  and some of the more recent desktop G5 machines as well.

config PPC_PASEMI_CPUFREQ
	bool "Support for PA Semi PWRficient"
	depends on PPC_PASEMI
	select CPU_FREQ_TABLE
	default y
	help
	  This adds the support for frequency switching on PA Semi
	  PWRficient processors.
```

## drivers/net/ethernet/freescale/dpa/Kconfig
```kconfig
config DPA_ETH
	bool "DPAA Ethernet"
	depends on FSL_SOC && FSL_BMAN && FSL_QMAN && FSL_FMAN
	select PHYLIB
	---help---
	  Data Path Acceleration Architecture Ethernet driver, supporting the
	  Freescale QorIQ chips.

config DPA_OFFLINE_PORTS
	bool "Offline Ports support"
	depends on DPA_ETH
	default y
	---help---
	  The Offline Parsing / Host Command ports (short: OH ports, of Offline ports) provide
	  most of the functionality of the regular, online ports, except they receive their
	  frames from a core or an accelerator on the SoC, via QMan frame queues,
	  rather than directly from the network.
	  Offline ports are configured via PCD (Parse-Classify-Distribute) schemes, just like
	  any online FMan port. They deliver the processed frames to frame queues, according
	  to the applied PCD configurations.

	  Choosing this feature will not impact the functionality and/or performance of the system,
	  so it is safe to have it.

config DPAA_ETH_SG_SUPPORT
	bool

choice DPAA_ETH_OPTIMIZE
	prompt "Optimization choices for the DPAA Ethernet driver"
	depends on DPA_ETH
	default DPAA_ETH_OPTIMIZE_FOR_TERM
	---help---
	  Compile-time switch between driver optimizations for forwarding use-cases and
	  termination scenarios.

	config DPAA_ETH_OPTIMIZE_FOR_IPFWD
		bool "Optimize for forwarding"
		select DPA_TX_RECYCLE if FMAN_T4240
		---help---
		  Optimize the DPAA-Ethernet driver for IP/IPSec forwarding use-cases.

	config DPAA_ETH_OPTIMIZE_FOR_TERM
		bool "Optimize for termination"
		select DPAA_ETH_SG_SUPPORT
		---help---
		  Optimize the DPAA-Ethernet driver for termination (TCP, UDP) use-cases.
		  In particular, this choice enables Scatter-Gather (SG) support
		  in the driver, which is momentarily not accessible otherwise.
endchoice

config DPA_TX_RECYCLE
	bool
	depends on FMAN_T4240

config FSL_DPA_1588
	tristate "IEEE 1588-compliant timestamping"
	depends on DPA_ETH
	default n

config FSL_DPA_TS
	tristate "Linux compliant timestamping"
	depends on DPA_ETH
	default n

choice DPA_ETH_WQ_ASSIGN
	prompt "WorkQueue assignment scheme for FrameQueues"
	depends on DPA_ETH
	default DPA_ETH_WQ_MULTI
	---help---
	  Selects the FrameQueue to WorkQueue assignment scheme.

	config DPA_ETH_WQ_LEGACY
		bool "Legacy WQ assignment"
		---help---
		  Statically-defined FQIDs are round-robin assigned to all WQs (0..7). PCD queues are always
		  in this category. Other frame queues may be those used for "MAC-less" or "shared MAC" configurations
		  of the driver.
		  Dynamically-defined FQIDs all go to WQ7.
	config DPA_ETH_WQ_MULTI
	bool "Multi-WQ assignment"
	---help---
	  Tx Confirmation FQs go to WQ1.
	  Rx Default, Tx and PCD FQs go to WQ3.
	  Rx Error and Tx Error FQs go to WQ2.
endchoice

config DPAA_ETH_USE_NDO_SELECT_QUEUE
	bool "Use driver's Tx queue selection mechanism"
	default y
	depends on DPA_ETH
	---help---
	  The DPAA-Ethernet driver defines a ndo_select_queue() callback for optimal selection
	  of the egress FQ. That will override the XPS support for this netdevice.
	  If for whatever reason you want to be in control of the egress FQ-to-CPU selection and mapping,
	  or simply don't want to use the driver's ndo_select_queue() callback, then unselect this
	  and use the standard XPS support instead.

config DPAA_ETH_UNIT_TESTS
	bool
	depends on DPA_ETH
	default n
```

## drivers/net/ethernet/freescale/fman/Kconfig
```kconfig
menu "Frame Manager support"

menuconfig FSL_FMAN
	bool "Freescale Frame Manager (datapath) support"
	depends on FSL_SOC && FSL_BMAN && FSL_QMAN
	default y
	---help---
		If unsure, say Y.

if FSL_FMAN

config FSL_FMAN_TEST
	bool "FMan test module"
	default n
	---help---
		This option compiles test code for FMan.

menu "FMAN Processor support"
choice
	depends on FSL_FMAN
	prompt "Processor Type"

config FMAN_P3040_P4080_P5020
	bool "P3040 P4080 5020"

config FMAN_P1023
	bool "P1023"

config FMAN_T4240
	bool "T4240"

endchoice
endmenu

config FMAN_V3L
	depends on FMAN_T4240
	bool "FMAN_V3L like T1040, T1042, T1020, T1022"
	default n
	---help---
	  There are two FMAN V3 version: FMAN_V3H and FMAN_V3L.
	  T1040, T1042, T1020, T1022, T1023, T1024 belong to FMAN_V3L, there
	  are 4 Offline/Host Command Ports (O/H n) in FMAN_V3L.
	  But there are 6 Offline/Host Command Ports (O/H n) in
	  FMAN_V3H.
	  Say "Y" if chips are T1040, T1042, T1020, T1022, T1023, T1024 family.

config FMAN_MIB_CNT_OVF_IRQ_EN
	bool "Enable the dTSEC MIB counters overflow interrupt"
	default n
	---help---
		Enable the dTSEC MIB counters overflow interrupt to get
		accurate MIB counters values. Enabled it compensates
		for the counters overflow but reduces performance and
		triggers error messages in HV setups.

config FSL_FM_MAX_FRAME_SIZE
	int "Maximum L2 frame size"
	depends on FSL_FMAN
	range 64 9600
	default "1522"
	help
		Configure this in relation to the maximum possible MTU of your
		network configuration. In particular, one would need to
		increase this value in order to use jumbo frames.
		FSL_FM_MAX_FRAME_SIZE must accommodate the Ethernet FCS (4 bytes)
		and one ETH+VLAN header (18 bytes), to a total of 22 bytes in
		excess of the desired L3 MTU.

		Note that having too large a FSL_FM_MAX_FRAME_SIZE (much larger
		than the actual MTU) may lead to buffer exhaustion, especially
		in the case of badly fragmented datagrams on the Rx path.
		Conversely, having a FSL_FM_MAX_FRAME_SIZE smaller than the actual
		MTU will lead to frames being dropped.

		This can be overridden by specifying "fsl_fm_max_frm" in
		the kernel bootargs:
		 * in Hypervisor-based scenarios, by adding a "chosen" node
		with the "bootargs" property specifying
		"fsl_fm_max_frm=<YourValue>";
		 * in non-Hypervisor-based scenarios, via u-boot's env, by
		modifying the "bootargs" env variable.

config FSL_FM_RX_EXTRA_HEADROOM
	int "Add extra headroom at beginning of data buffers"
	depends on FSL_FMAN
	range 16 384
	default "64"
	help
		Configure this to tell the Frame Manager to reserve some extra
		space at the beginning of a data buffer on the receive path,
		before Internal Context fields are copied. This is in addition
		to the private data area already reserved for driver internal
		use. The provided value must be a multiple of 16.

		This setting can be overridden by specifying
		"fsl_fm_rx_extra_headroom" in the kernel bootargs:
		 * in Hypervisor-based scenarios, by adding a "chosen" node
		with the "bootargs" property specifying
		"fsl_fm_rx_extra_headroom=<YourValue>";
		 * in non-Hypervisor-based scenarios, via u-boot's env, by
		modifying the "bootargs" env variable.

config FMAN_PFC
	bool "FMan PFC support (EXPERIMENTAL)"
	depends on FMAN_T4240 && FSL_FMAN
	default n
	---help---
	  This option enables PFC support on FMan v3 ports.
	  Data Center Bridging defines Classes of Service that are
	  flow-controlled using PFC pause frames.

if FMAN_PFC
config FMAN_PFC_COS_COUNT
	int "Number of PFC Classes of Service"
	depends on FMAN_PFC && FSL_FMAN
	range 1 4
	default "3"
	---help ---
	  The number of Classes of Service controlled by PFC.

config FMAN_PFC_QUANTA_0
	int "The pause quanta for PFC CoS 0"
	depends on FMAN_PFC && FSL_FMAN
	range 0 65535
	default "65535"

config FMAN_PFC_QUANTA_1
	int "The pause quanta for PFC CoS 1"
	depends on FMAN_PFC && FSL_FMAN
	range 0 65535
	default "65535"

config FMAN_PFC_QUANTA_2
	int "The pause quanta for PFC CoS 2"
	depends on FMAN_PFC && FSL_FMAN
	range 0 65535
	default "65535"

config FMAN_PFC_QUANTA_3
	int "The pause quanta for PFC CoS 3"
	depends on FMAN_PFC && FSL_FMAN
	range 0 65535
	default "65535"
endif

endif # FSL_FMAN

endmenu
```

## drivers/pci/host/Kconfig
```kconfig
menu "PCI host controller drivers"
	depends on PCI

config PCI_MVEBU
	bool "Marvell EBU PCIe controller"
	depends on ARCH_MVEBU || ARCH_KIRKWOOD
	depends on OF

config PCIE_DW
	bool

config PCI_EXYNOS
	bool "Samsung Exynos PCIe controller"
	depends on SOC_EXYNOS5440
	select PCIEPORTBUS
	select PCIE_DW

config PCI_TEGRA
	bool "NVIDIA Tegra PCIe controller"
	depends on ARCH_TEGRA

config PCI_LAYERSCAPE
	bool "Freescale Layerscape PCIe controller"
	depends on OF
	select PCIE_DW
	select MFD_SYSCON
	help
	  Say Y here if you want PCIe controller support on Layerscape SoCs.

endmenu
```

## drivers/platform/fsl/Kconfig
```kconfig
#
# Freescale Specific Power Management Drivers
#

config FSL_SLEEP_FSM
	bool
	help
	  This driver configures a hardware FSM (Finite State Machine) for deep sleep.
	  The FSM is used to finish clean-ups at the last stage of system entering deep
	  sleep, and also wakes up system when a wake up event happens.
```

## drivers/soc/Kconfig
```kconfig
menu "SOC (System On Chip) specific Drivers"

config	FSL_SOC_DRIVERS
	bool "Freescale Soc Drivers"
	depends on FSL_SOC || ARCH_MXC
	default n
	help
	Say y here to enable Freescale Soc Device Drivers support.
	The Soc Drivers provides the device driver that is a specific block
	or feature on Freescale platform.

if FSL_SOC_DRIVERS
	source "drivers/soc/fsl/Kconfig"
endif

source drivers/soc/qe/Kconfig

endmenu
```
